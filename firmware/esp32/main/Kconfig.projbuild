## firmware/esp32/main/Kconfig.projbuild
```kconfig
menu "Aura Lily"

config AURA_WS_URI_DEFAULT
    string "Default Aura Lily WebSocket server URI"
    default ""
    help
        Optional WebSocket endpoint used when no server URL has been saved
        through the provisioning page. Leave empty for a self-configured
        public build and set the address during provisioning.

config AURA_OTA_MANIFEST_URL
    string "OTA application manifest URL"
    default ""
    help
        HTTPS URL for the application OTA manifest. Leave empty to keep OTA
        disabled until you configure your own release host.

config AURA_OTA_RESOURCES_MANIFEST_URL
    string "OTA resource manifest URL"
    default ""
    help
        HTTPS URL for the resource-only OTA manifest. Leave empty when your
        deployment does not publish resources separately.

endmenu
```

## firmware/esp32/sdkconfig.defaults
```kconfig
# ESP-IDF 默认配置
CONFIG_ESPTOOLPY_FLASHSIZE_16MB=y
CONFIG_PARTITION_TABLE_CUSTOM=y
CONFIG_PARTITION_TABLE_CUSTOM_FILENAME="partitions.csv"
CONFIG_BOOTLOADER_APP_ROLLBACK_ENABLE=y

# PSRAM
CONFIG_SPIRAM=y
CONFIG_SPIRAM_MODE_OCT=y
CONFIG_SPIRAM_SPEED_80M=y
CONFIG_SPIRAM_MALLOC_ALWAYSINTERNAL=4096
CONFIG_SPIRAM_TRY_ALLOCATE_WIFI_LWIP=y

# CPU
CONFIG_ESP32S3_DEFAULT_CPU_FREQ_240=y

# FreeRTOS
CONFIG_FREERTOS_HZ=1000
CONFIG_FREERTOS_TIMER_TASK_STACK_DEPTH=4096

# WiFi
CONFIG_ESP_WIFI_SOFTAP_SUPPORT=y

# WebSocket
CONFIG_ESP_WS_CLIENT_ENABLE=y
CONFIG_WS_BUFFER_SIZE=4096
CONFIG_ESP_WS_CLIENT_ENABLE_DYNAMIC_BUFFER=y
CONFIG_AURA_WS_URI_DEFAULT=""
CONFIG_AURA_OTA_MANIFEST_URL=""
CONFIG_AURA_OTA_RESOURCES_MANIFEST_URL=""

# TLS / mbedTLS
CONFIG_MBEDTLS_EXTERNAL_MEM_ALLOC=y
CONFIG_MBEDTLS_DYNAMIC_BUFFER=y
CONFIG_MBEDTLS_SSL_VARIABLE_BUFFER_LENGTH=y

# SD Card
CONFIG_SDMMC_SUPPORT=y

# Log
CONFIG_LOG_DEFAULT_LEVEL_INFO=y
CONFIG_ESP_AUDIO_SIMPLE_PLAYER_FILE_EN=y
CONFIG_ESP_AUDIO_SIMPLE_PLAYER_HTTP_EN=n
CONFIG_ESP_AUDIO_SIMPLE_PLAYER_EMBED_FLASH_EN=n
CONFIG_ESP_AUDIO_SIMPLE_PLAYER_RESAMPLE_EN=y
CONFIG_AUDIO_SIMPLE_PLAYER_RESAMPLE_DEST_RATE=16000
CONFIG_ESP_AUDIO_SIMPLE_PLAYER_CH_CVT_EN=y
CONFIG_AUDIO_SIMPLE_PLAYER_CH_CVT_DEST=1
CONFIG_AUDIO_DECODER_AAC_SUPPORT=n
CONFIG_AUDIO_DECODER_G711_SUPPORT=n
CONFIG_AUDIO_DECODER_AMRNB_SUPPORT=n
CONFIG_AUDIO_DECODER_AMRWB_SUPPORT=n
CONFIG_AUDIO_DECODER_FLAC_SUPPORT=n
CONFIG_AUDIO_DECODER_OPUS_SUPPORT=n
CONFIG_AUDIO_DECODER_VORBIS_SUPPORT=n
CONFIG_AUDIO_DECODER_ADPCM_SUPPORT=n
CONFIG_AUDIO_DECODER_ALAC_SUPPORT=n
CONFIG_AUDIO_DECODER_SBC_SUPPORT=n
CONFIG_AUDIO_DECODER_LC3_SUPPORT=n
CONFIG_AUDIO_ENCODER_AAC_SUPPORT=n
CONFIG_AUDIO_ENCODER_G711_SUPPORT=n
CONFIG_AUDIO_ENCODER_AMRNB_SUPPORT=n
CONFIG_AUDIO_ENCODER_AMRWB_SUPPORT=n
CONFIG_AUDIO_ENCODER_OPUS_SUPPORT=n
CONFIG_AUDIO_ENCODER_ADPCM_SUPPORT=n
CONFIG_AUDIO_ENCODER_ALAC_SUPPORT=n
CONFIG_AUDIO_ENCODER_SBC_SUPPORT=n
CONFIG_AUDIO_ENCODER_LC3_SUPPORT=n
CONFIG_ESP_CONSOLE_USB_SERIAL_JTAG=y
CONFIG_ESP_CONSOLE_SECONDARY_NONE=y
```
